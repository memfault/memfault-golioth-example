## CMakeLists.txt
```
# Copyright (c) 2023 Golioth, Inc.
# SPDX-License-Identifier: Apache-2.0

cmake_minimum_required(VERSION 3.20.0)

find_package(Zephyr REQUIRED HINTS $ENV{ZEPHYR_BASE})

project(golioth_memfault)

zephyr_include_directories(config)

target_sources(app PRIVATE
    src/main.c
    src/golioth_memfault.c
    src/memfault_port.c
)
```

## Kconfig
```
# Copyright (c) 2023 Golioth, Inc.
# SPDX-License-Identifier: Apache-2.0

source "Kconfig.zephyr"

config APP_MEMFAULT_UPLOAD_INTERVAL_SECS
    int "Memfault upload interval in seconds"
    default 3600
    help
      The interval at which the Memfault agent will attempt to upload data to the Memfault cloud.
      This is a minimum value; the actual upload may happen less frequently depending on network conditions.
```

## west.yml
```
# Copyright (c) 2023 Golioth, Inc.
# SPDX-License-Identifier: Apache-2.0

manifest:
  version: 0.8

  remotes:
  - name: memfault
    url-base: https://github.com/memfault

  projects:
    - name: golioth
      path: modules/lib/golioth-firmware-sdk
      revision: v0.14.0
      url: https://github.com/golioth/golioth-firmware-sdk
      submodules: true
      import:
        file: west-zephyr.yml
        path-prefix: deps
        name-allowlist:
          - zephyr
          - cmsis
          - hal_espressif
          - hal_nordic
          - hal_nxp
          - mbedtls
          - mcuboot
          - net-tools
          - segger
          - tfm-mcuboot
          - tinycrypt
          - trusted-firmware-m
          - zcbor

    - name: memfault-firmware-sdk
      path: deps/modules/lib/memfault-firmware-sdk
      revision: 1.9.4
      remote: memfault

  self:
    path: app
```

## prj.conf
```kconfig
# Golioth Firmware SDK
CONFIG_GOLIOTH_FIRMWARE_SDK=y
CONFIG_GOLIOTH_RPC=y
CONFIG_GOLIOTH_STREAM=y

# Memfault SDK
CONFIG_MEMFAULT=y
CONFIG_ASSERT=y
CONFIG_THREAD_RUNTIME_STATS=y
CONFIG_NET_STATISTICS=y
CONFIG_NET_STATISTICS_USER_API=y
CONFIG_NET_STATISTICS_UDP=y
CONFIG_HWINFO=y  # for device serial number

# Configure Golioth SDK dependencies
CONFIG_EVENTFD_MAX=14
CONFIG_LOG_PROCESS_THREAD_STACK_SIZE=1536
CONFIG_MBEDTLS_ENABLE_HEAP=y
CONFIG_MBEDTLS_HEAP_SIZE=10240
CONFIG_NETWORKING=y
CONFIG_NET_IPV4=y
CONFIG_POSIX_MAX_FDS=23
CONFIG_HEAP_MEM_POOL_SIZE=4096

# MbedTLS configuration to support p-384 curve. These options
# enable using the MbedTLS built-in support for operations not
# supported by the default nRF Oberon crypto backend
CONFIG_NORDIC_SECURITY_BACKEND=n
CONFIG_MBEDTLS_LEGACY_CRYPTO_C=y

# Runtime credentials config
CONFIG_FLASH=y
CONFIG_FLASH_MAP=y
CONFIG_NVS=y
CONFIG_SETTINGS=y
CONFIG_SETTINGS_RUNTIME=y
CONFIG_GOLIOTH_SAMPLE_COMMON=y
CONFIG_GOLIOTH_SAMPLE_AUTH_TYPE_TAG=y
CONFIG_GOLIOTH_SAMPLE_SETTINGS_AUTOLOAD=y
CONFIG_GOLIOTH_SAMPLE_SETTINGS_SHELL=y

# Application

CONFIG_LOG=y
CONFIG_MAIN_STACK_SIZE=2048
CONFIG_SYSTEM_WORKQUEUE_STACK_SIZE=2048
CONFIG_NET_LOG=y
CONFIG_NET_SHELL=y
CONFIG_REBOOT=y
```

## boards/esp32s3_devkitm.conf
```kconfig
CONFIG_WIFI=y
CONFIG_NET_L2_WIFI_SHELL=y

CONFIG_NETWORKING=y
CONFIG_NET_L2_ETHERNET=y

CONFIG_NET_IPV6=n
CONFIG_NET_IPV4=y
CONFIG_NET_DHCPV4=y
CONFIG_ESP32_WIFI_STA_AUTO_DHCPV4=y

CONFIG_NET_LOG=y
```

## boards/mimxrt1024_evk.conf
```kconfig
CONFIG_GOLIOTH_SAMPLE_DHCP_BIND=y
CONFIG_NET_L2_ETHERNET=y
CONFIG_NET_DHCPV4=y
CONFIG_BUILD_OUTPUT_HEX=y

# Options not shared with nRF Connect SDK
CONFIG_MBEDTLS_SSL_MAX_CONTENT_LEN=2048
```

## boards/nrf7002dk_nrf5340_cpuapp.conf
```kconfig
# General config
CONFIG_HEAP_MEM_POOL_SIZE=153600
CONFIG_NEWLIB_LIBC=y

CONFIG_WIFI=y
CONFIG_NET_L2_WIFI_SHELL=y
CONFIG_SHELL_STACK_SIZE=4096
CONFIG_WIFI_NM_WPA_SUPPLICANT=y
CONFIG_NET_DHCPV4=y
CONFIG_NET_L2_ETHERNET=y
CONFIG_NET_PKT_RX_COUNT=8
CONFIG_NET_PKT_TX_COUNT=8
CONFIG_NET_BUF_RX_COUNT=32
CONFIG_NET_BUF_TX_COUNT=32
CONFIG_NET_BUF_DATA_SIZE=128
CONFIG_NET_TC_TX_COUNT=1
CONFIG_NET_IF_UNICAST_IPV4_ADDR_COUNT=1
CONFIG_NET_MAX_CONTEXTS=5
CONFIG_NET_CONTEXT_SYNC_RECV=y
CONFIG_INIT_STACKS=y

CONFIG_NRF_SECURITY=y

CONFIG_MAIN_STACK_SIZE=4096
CONFIG_NET_TX_STACK_SIZE=4096
CONFIG_NET_RX_STACK_SIZE=4096

# Disable options y-selected by NCS for no good reason
CONFIG_MBEDTLS_KEY_EXCHANGE_DHE_PSK_ENABLED=n
CONFIG_MBEDTLS_KEY_EXCHANGE_DHE_RSA_ENABLED=n

# NCS specific configuration
CONFIG_MBEDTLS_SSL_OUT_CONTENT_LEN=2048
CONFIG_MBEDTLS_SSL_IN_CONTENT_LEN=2048
# NCS requires a key, though it is unused in this app
CONFIG_MEMFAULT_NCS_PROJECT_KEY="_"
CONFIG_MEMFAULT_NCS_FW_TYPE="_"

CONFIG_GOLIOTH_SAMPLE_WIFI=y
```

## boards/nrf9160dk_nrf9160_ns.conf
```kconfig
# General config
CONFIG_HEAP_MEM_POOL_SIZE=4096
CONFIG_NEWLIB_LIBC=y

# Networking
CONFIG_NET_SOCKETS_OFFLOAD=y
CONFIG_NET_IPV6=y
CONFIG_NET_IPV6_NBR_CACHE=n
CONFIG_NET_IPV6_MLD=n

# Increase native TLS socket implementation, so that it is chosen instead of
# offloaded nRF91 sockets
CONFIG_NET_SOCKETS_TLS_PRIORITY=35

# Modem library
CONFIG_NRF_MODEM_LIB=y

# LTE connectivity with network connection manager
CONFIG_NRF_MODEM_LIB_NET_IF=y
CONFIG_NRF_MODEM_LIB_NET_IF_AUTO_START=y
CONFIG_NRF_MODEM_LIB_NET_IF_AUTO_CONNECT=y
CONFIG_NET_CONNECTION_MANAGER=y
CONFIG_NET_CONNECTION_MANAGER_MONITOR_STACK_SIZE=1024

# Increased sysworkq size, due to LTE connectivity
CONFIG_SYSTEM_WORKQUEUE_STACK_SIZE=2048

# Disable options y-selected by NCS for no good reason
CONFIG_MBEDTLS_KEY_EXCHANGE_DHE_PSK_ENABLED=n
CONFIG_MBEDTLS_KEY_EXCHANGE_DHE_RSA_ENABLED=n

# Generate MCUboot compatible images
CONFIG_BOOTLOADER_MCUBOOT=y

# NCS specific configuration
CONFIG_MBEDTLS_SSL_OUT_CONTENT_LEN=2048
CONFIG_MBEDTLS_SSL_IN_CONTENT_LEN=2048

# Memfault HTTP client is enabled by default for the nRF91, but unused in this app
CONFIG_MEMFAULT_HTTP_ENABLE=n
```

## src/main.c
```c
/*
 * Copyright (c) 2024 Golioth, Inc.
 *
 * SPDX-License-Identifier: Apache-2.0
 */

#include <zephyr/logging/log.h>
LOG_MODULE_REGISTER(main, LOG_LEVEL_INF);

#include <zephyr/kernel.h>
#include <zephyr/sys/__assert.h>
#include <zephyr/settings/settings.h>

#include <golioth/client.h>
#include <golioth/rpc.h>

#include <memfault/components.h>

#include <samples/common/sample_credentials.h>
#include <samples/common/net_connect.h>

#include "golioth_memfault.h"

static K_SEM_DEFINE(connected, 0, 1);
#define BUILD_ID_LEN 6

static void on_golioth_client_event(struct golioth_client *client, enum golioth_client_event event, void *arg) {
    bool is_connected = (event == GOLIOTH_CLIENT_EVENT_CONNECTED);
    if (is_connected) {
        k_sem_give(&connected);
    }
    LOG_INF("Golioth client %s", is_connected ? "connected" : "disconnected");
}

int main(void)
{
    LOG_INF("Starting Golioth + Memfault example application");

    // Disable temporarily for testing purposes
    // net_connect();

    const struct golioth_client_config *client_config = golioth_sample_credentials_get();

    struct golioth_client *client = golioth_client_create(client_config);
    struct golioth_rpc *rpc = golioth_rpc_init(client);

    golioth_client_register_event_callback(client, on_golioth_client_event, NULL);

    k_sem_take(&connected, K_FOREVER);

    golioth_memfault_init(client, rpc);

    while(true)
    {
        k_sleep(K_FOREVER);
    }
}
```

## src/golioth_memfault.c
```c
/*
 * Copyright (c) 2024 Golioth, Inc.
 *
 * SPDX-License-Identifier: Apache-2.0
 */
#include <zephyr/logging/log.h>
LOG_MODULE_REGISTER(golioth_memfault, LOG_LEVEL_DBG);

#include <zephyr/kernel.h>

#include <golioth/client.h>
#include <golioth/rpc.h>
#include <golioth/stream.h>
#include <memfault/components.h>

#include "golioth_memfault.h"

struct memfault_work_ctx
{
    struct k_work work;
    struct golioth_client *client;
};

static struct memfault_work_ctx mflt_ctx;

static void memfault_work_handler(struct k_work *work)
{
    struct memfault_work_ctx *ctx = CONTAINER_OF(work, struct memfault_work_ctx, work);
    golioth_memfault_upload(ctx->client);
}

static void mflt_upload_timer_expired(struct k_timer *timer)
{
    /* This function is executed in an interrupt context, so all we do
       here is schedule work on the system work queue */
    struct memfault_work_ctx *ctx = k_timer_user_data_get(timer);
    k_work_submit(&ctx->work);
}
K_TIMER_DEFINE(mflt_upload_timer, mflt_upload_timer_expired, NULL);

static void coredump_timer_expired(struct k_timer *timer)
{
    #if !defined(CONFIG_SOC_FAMILY_ESP32)
    memfault_arch_disable_configurable_faults();
    #endif
    int *bad = (int *) 0;
    *bad = -1;
}
K_TIMER_DEFINE(coredump_timer, coredump_timer_expired, NULL);

/* Golioth RPC for triggering an assert in order to capture a Memfault coredump */
static enum golioth_rpc_status coredump_rpc(zcbor_state_t *request_params_array,
                                        zcbor_state_t *response_detail_map,
                                        void *callback_arg)
{
    /* Assert after timer expiration to allow time for sending the RPC response */
    k_timer_start(&coredump_timer, K_SECONDS(5), K_SECONDS(0));
    LOG_INF("Coredump requested, resetting in 5 seconds");
    return GOLIOTH_OK;
}

/* Golioth RPC for triggering an immediate upload of any pending Memfault data */
static enum golioth_rpc_status memfault_upload_rpc(zcbor_state_t *request_params_array,
                                        zcbor_state_t *response_detail_map,
                                        void *callback_arg)
{
    /* This function is executed on the Golioth CoAP Client thread. To avoid
       deadlocking that thread, we will perform the blocking upload operation
       on the System Workqueue. */
    struct memfault_work_ctx *ctx = callback_arg;

    k_work_submit(&ctx->work);
    return GOLIOTH_OK;
}

/* Callback invoked by the Golioth SDK to read the next block of Memfault
   data to send to Goliot */
static enum golioth_status read_memfault_chunk(uint32_t block_idx,
                                               uint8_t *block_buffer,
                                               size_t *block_size,
                                               bool *is_last,
                                               void *arg)
{
    eMemfaultPacketizerStatus mflt_status;
    mflt_status = memfault_packetizer_get_next(block_buffer, block_size);
    if (kMemfaultPacketizerStatus_NoMoreData == mflt_status)
    {
        /* We should not hit this, but can recover */
        LOG_WRN("Unexpected end of Memfault data");
        *block_size = 0;
        *is_last = true;
    }
    else if (kMemfaultPacketizerStatus_EndOfChunk == mflt_status)
    {
        /* Last block */
        *is_last = true;
    }
    else if (kMemfaultPacketizerStatus_MoreDataForChunk == mflt_status)
    {
        *is_last = false;
    }

    return GOLIOTH_OK;
}

int golioth_memfault_upload(struct golioth_client *client)
{
    /* Configure the Memfault SDK to read maximum sized chunks across
       multiple calls */
    sPacketizerConfig cfg = {
        .enable_multi_packet_chunk = true,
    };
    sPacketizerMetadata metadata = {};
    bool data_available = memfault_packetizer_begin(&cfg, &metadata);
    while (data_available)
    {
        LOG_DBG("Uploading memfault data");
        /* TODO make this non-blocking */
        golioth_stream_set_blockwise_sync(client,
                                          "mflt",
                                          GOLIOTH_CONTENT_TYPE_OCTET_STREAM,
                                          read_memfault_chunk,
                                          NULL);

        /* Check for additional chunks */
        data_available = memfault_packetizer_begin(&cfg, &metadata);
    }

    return 0;
}

int golioth_memfault_init(struct golioth_client *client, struct golioth_rpc *rpc)
{
    /* Initialize periodic timer for uploading data to Memfault */
    k_work_init(&mflt_ctx.work, memfault_work_handler);
    mflt_ctx.client = client;
    k_timer_user_data_set(&mflt_upload_timer, &mflt_ctx);
    k_timer_start(&mflt_upload_timer, K_SECONDS(5), K_SECONDS(CONFIG_APP_MEMFAULT_UPLOAD_INTERVAL_SECS));

    /* Register RPCs. These aren't necessary for routing Memfault data through
       Golioth, but can be useful for testing and debugging */
    golioth_rpc_register(rpc, "coredump", coredump_rpc, NULL);
    golioth_rpc_register(rpc, "memfault_upload", memfault_upload_rpc, &mflt_ctx.work);

    return 0;
}
```

## src/golioth_memfault.h
```c
/*
 * Copyright (c) 2024 Golioth, Inc.
 *
 * SPDX-License-Identifier: Apache-2.0
 */

#include <golioth/client.h>
#include <golioth/rpc.h>

int golioth_memfault_upload(struct golioth_client *client);
int golioth_memfault_init(struct golioth_client *client, struct golioth_rpc *rpc);
```

## src/memfault_port.c
```c
/*
 * Copyright (c) 2025 Golioth, Inc.
 *
 * SPDX-License-Identifier: Apache-2.0
 */

#include "memfault/components.h"

// Expand RAM range, e.g. to allow malloc-ed thread TCBs to be included in coredumps
size_t memfault_platform_sanitize_address_range(void *start_addr, size_t desired_size) {
  extern uint32_t __kernel_ram_start[];
  extern uint32_t __kernel_ram_end[];

  const uint32_t ram_start = (uint32_t)__kernel_ram_start;
  const uint32_t ram_end = (uint32_t)__kernel_ram_end;

  if ((uint32_t)start_addr >= ram_start && (uint32_t)start_addr < ram_end) {
    return MEMFAULT_MIN(desired_size, ram_end - (uint32_t)start_addr);
  }

  return 0;
}
```
